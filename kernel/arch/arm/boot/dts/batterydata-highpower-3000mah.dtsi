/* Copyright (c) 2013, The Linux Foundation. All rights reserved.
 *
 * This program is free software; you can redistribute it and/or modify
 * it under the terms of the GNU General Public License version 2 and
 * only version 2 as published by the Free Software Foundation.
 *
 * This program is distributed in the hope that it will be useful,
 * but WITHOUT ANY WARRANTY; without even the implied warranty of
 * MERCHANTABILITY or FITNESS FOR A PARTICULAR PURPOSE.  See the
 * GNU General Public License for more details.
 */

qcom,highpower-3000mah {
	qcom,fcc-mah = <3000>;
	qcom,default-rbatt-mohm = <117>;
	qcom,max-voltage-uv = <4200000>;
	qcom,rbatt-capacitive-mohm = <0>;
	qcom,v-cutoff-uv = <3000000>;
	qcom,chg-term-ua = <150000>;
	qcom,batt-id-kohm = <10>;

	qcom,fcc-temp-lut {
		qcom,lut-col-legend = <(-20) (-5) 0 25 40 45 60>;
		qcom,lut-data = <3030 3031 3033 3037 3035 3033 3031>;
	};

	qcom,pc-temp-ocv-lut {
		qcom,lut-col-legend = <(-20) (-5) 0 25 40 45 60>;
		qcom,lut-row-legend = <100 95 90 85 80>,
				<75 70 65 60 55>,
				<50 45 40 35 30>,
				<25 20 16 13 11>,
				<10 9 8 7 6>,
				<5 4 3 2 1>,
				<0>;
		qcom,lut-data = <4131 4136 4138 4139 4138 4137 4135>,
				<4062 4078 4082 4093 4096 4098 4098>,
				<4028 4050 4054 4068 4073 4074 4075>,
				<4008 4034 4040 4056 4060 4060 4061>,
				<3989 4022 4028 4046 4050 4050 4050>,
				<3964 4008 4016 4040 4042 4042 4042>,
				<3936 3991 4000 4030 4033 4032 4032>,
				<3909 3970 3980 4010 4014 4014 4013>,
				<3886 3948 3958 3984 3986 3986 3985>,
				<3867 3922 3933 3956 3960 3960 3960>,
				<3851 3900 3910 3932 3936 3936 3938>,
				<3835 3880 3890 3912 3916 3916 3918>,
				<3819 3862 3873 3896 3900 3900 3902>,
				<3803 3844 3857 3880 3885 3887 3890>,
				<3784 3823 3840 3862 3864 3864 3862>,
				<3764 3804 3814 3839 3840 3838 3837>,
				<3737 3786 3791 3813 3812 3812 3810>,
				<3710 3770 3774 3790 3789 3788 3786>,
				<3678 3750 3758 3770 3770 3770 3768>,
				<3656 3737 3748 3758 3758 3758 3757>,
				<3644 3730 3743 3752 3752 3752 3751>,
				<3629 3710 3724 3734 3734 3740 3746>,
				<3598 3688 3701 3712 3710 3712 3716>,
				<3568 3664 3678 3690 3686 3684 3680>,
				<3538 3641 3656 3669 3662 3655 3644>,
				<3508 3618 3632 3647 3638 3627 3609>,
				<3478 3594 3610 3626 3614 3599 3573>,
				<3449 3516 3530 3546 3545 3570 3538>,
				<3295 3306 3314 3322 3330 3368 3429>,
				<3119 3101 3102 3102 3104 3124 3152>,
				<3000 3000 3000 3000 3000 3000 3000>;
	};

	qcom,rbatt-sf-lut {
		qcom,lut-col-legend = <(-20) (-5) 0 25 40 45 60>;
		qcom,lut-row-legend = <100 95 90 85 80>,
				<75 70 65 60 55>,
				<50 45 40 35 30>,
				<25 20 16 13 11>,
				<10 9 8 7 6>,
				<5 4 3 2 1>;
		qcom,lut-data = <855 335 250 100 84 83 79>,
				<855 335 250 100 84 83 79>,
				<889 343 255 100 84 83 79>,
				<929 355 262 102 85 83 79>,
				<954 372 275 106 85 84 80>,
				<945 387 285 113 89 86 82>,
				<926 396 294 124 97 92 86>,
				<913 395 295 124 98 94 86>,
				<910 385 291 114 92 88 83>,
				<922 373 278 104 86 84 81>,
				<947 363 270 103 85 83 80>,
				<979 359 267 103 85 83 80>,
				<1022 358 268 103 86 84 81>,
				<1079 359 271 105 89 87 84>,
				<1157 361 275 105 87 84 80>,
				<1267 379 268 103 85 82 80>,
				<1417 414 275 103 85 82 80>,
				<1565 452 297 104 85 82 80>,
				<1948 501 345 103 85 85 81>,
				<2217 533 378 103 86 85 82>,
				<2352 549 392 103 86 85 82>,
				<2580 574 412 105 87 85 82>,
				<3205 602 431 108 87 85 84>,
				<3800 627 450 109 88 86 84>,
				<4394 656 468 111 88 87 85>,
				<4989 681 487 113 89 89 86>,
				<5582 709 506 116 89 89 87>,
				<6154 7786 5704 4212 3096 91 90>,
				<46827 31203 23496 18845 16879 13110 5533>,
				<95469 54014 41032 33256 31280 29779 22361>;
	};
};
